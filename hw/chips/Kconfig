## hw/pic16/Kconfig
```kconfig
config PIC16_SOC
    bool
    select UNIMP
    select SSI
    select PTIMER

config PIC16F17546
    bool
    default y
    depends on PIC16
    select PIC16_SOC

config PIC16_DEVBOARD
    bool
    default y
    depends on PIC16
    select PIC16_SOC
    select SPLIT_IRQ
    select MCP23S08
    select WS2812

config PIC16_TEST
    bool
    default y
    depends on PIC16
```

## hw/pic18/Kconfig
```kconfig
config PIC18_SOC
    bool
    select UNIMP
    select SSI
    select PTIMER

config PIC18F27Q43
    bool
    default y
    depends on PIC18
    select PIC18_SOC

config PIC18_DEVBOARD
    bool
    default y
    depends on PIC18
    select PIC18_SOC
    select SPLIT_IRQ
    select ADF4002
    select AD9834
    select MCP4822

config PIC18_TEST
    bool
    default y
    depends on PIC18
```

## hw/pic32/Kconfig
```kconfig
config PIC32MK_SOC
    bool
    select UNIMP
    select SSI
    select PTIMER

config PIC32_DEVBOARD
    bool
    default y
    depends on MIPS
    select PIC32MK_SOC
    select SPLIT_IRQ
    select MCP23S08
    select SSI_SD
    select PARALLEL_SRAM
    select LED_DEMUX
    select WS2812
    select WS2812_PANEL
    select FM_TRANSMITTER
    select FM_LINK
    select SD
```
